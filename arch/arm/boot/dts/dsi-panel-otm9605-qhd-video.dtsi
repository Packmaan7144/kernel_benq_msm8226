/* Copyright (c) 2013, The Linux Foundation. All rights reserved.
 *
 * This program is free software; you can redistribute it and/or modify
 * it under the terms of the GNU General Public License version 2 and
 * only version 2 as published by the Free Software Foundation.
 *
 * This program is distributed in the hope that it will be useful,
 * but WITHOUT ANY WARRANTY; without even the implied warranty of
 * MERCHANTABILITY or FITNESS FOR A PARTICULAR PURPOSE.  See the
 * GNU General Public License for more details.
 */

/*---------------------------------------------------------------------------
 * This file is autogenerated file using gcdb parser. Please do not edit it.
 * Update input XML file to add a new entry or update variable in this file
 * VERSION = "1.0"
 *---------------------------------------------------------------------------*/
&mdss_mdp {
	dsi_otm9605_qhd_vid: qcom,mdss_dsi_otm9605_qhd_video {
		qcom,mdss-dsi-panel-name = "otm9605 qhd video mode dsi panel";
		qcom,mdss-dsi-panel-controller = <&mdss_dsi0>;
		qcom,mdss-dsi-panel-type = "dsi_video_mode";
		qcom,mdss-dsi-panel-destination = "display_1";
		qcom,mdss-dsi-panel-framerate = <62>;
		qcom,mdss-dsi-virtual-channel-id = <0>;
		qcom,mdss-dsi-stream = <0>;
		qcom,mdss-dsi-panel-width = <540>;
		qcom,mdss-dsi-panel-height = <960>;
		qcom,mdss-dsi-h-front-porch = <6>;
		qcom,mdss-dsi-h-back-porch = <16>;
		qcom,mdss-dsi-h-pulse-width = <16>;
		qcom,mdss-dsi-h-sync-skew = <0>;
		qcom,mdss-dsi-v-back-porch = <6>;
		qcom,mdss-dsi-v-front-porch = <8>;
		qcom,mdss-dsi-v-pulse-width = <6>;
		qcom,mdss-dsi-h-left-border = <0>;
		qcom,mdss-dsi-h-right-border = <0>;
		qcom,mdss-dsi-v-top-border = <0>;
		qcom,mdss-dsi-v-bottom-border = <0>;
		qcom,mdss-dsi-bpp = <24>;
		qcom,mdss-dsi-color-order = <0>;
		qcom,mdss-pan-physical-width-dimension = <56>;
		qcom,mdss-pan-physical-height-dimension = <99>;
		qcom,mdss-dsi-underflow-color = <0xff>;
		qcom,mdss-dsi-border-color = <0>;
		qcom,mdss-dsi-on-command-head = [
					39 01 00 00 00 00 02
						00 00
					39 01 00 00 00 00 04
						FF 96 05 01
					39 01 00 00 00 00 02
						00 80
					39 01 00 00 00 00 03
						FF 96 05
					39 01 00 00 00 00 02
						00 92
					39 01 00 00 00 00 03
						FF 10 02

					39 01 00 00 00 00 02
						00 B4
					39 01 00 00 00 00 02
						C0 50
					39 01 00 00 00 00 02
						00 80
					39 01 00 00 00 00 03
						C1 36 77

					39 01 00 00 00 00 02
						00 89
					39 01 00 00 00 00 02
						C0 01
					39 01 00 00 00 00 02
						00 A0
					39 01 00 00 00 00 02
						C1 00
					39 01 00 00 00 00 02
						00 80
					39 01 00 00 00 00 05
						C5 08 00 A0 11
					39 01 00 00 00 00 02
						00 90
					39 01 00 00 00 00 08
						C5 96 57 01 03 55 55 31
					39 01 00 00 00 00 02
						00 B0
					39 01 00 00 00 00 03
						C5 05 28

					39 01 00 00 00 00 02
						00 00
					39 01 00 00 00 00 03
						D8 85 85
					39 01 00 00 00 00 02
						00 00
					39 01 00 00 00 00 02
						D9 69
					39 01 00 00 00 00 02
						00 A6
					39 01 00 00 00 00 02
						C1 01
					39 01 00 00 00 00 02
						00 A2
					39 01 00 00 00 00 04
						C0 0C 05 02
					39 01 00 00 00 00 02
						00 80
					39 01 00 00 00 00 0B
						CB 00 00 00 00 00 00 00 00 00 00

					39 01 00 00 00 00 02
						00 90
					39 01 00 00 00 00 10
						CB 00 00 00 00 00 00 00 00 00 00 00 00 00 00 00
					39 01 00 00 00 00 02
						00 A0
					39 01 00 00 00 00 10
						CB 00 00 00 00 00 00 00 00 00 00 00 00 00 00 00
					39 01 00 00 00 00 02
						00 B0
					39 01 00 00 00 00 0B
						CB 00 00 00 00 00 00 00 00 00 00
					39 01 00 00 00 00 02
						00 C0
					39 01 00 00 00 00 10
						CB 04 04 04 04 08 04 08 04 08 04 08 04 04 04 08
					39 01 00 00 00 00 02
						00 D0
					39 01 00 00 00 00 10
						CB 08 00 00 00 00 04 04 04 04 08 04 08 04 08 04

					39 01 00 00 00 00 02
						00 E0
					39 01 00 00 00 00 0B
						CB 08 04 04 04 08 08 00 00 00 00
					39 01 00 00 00 00 02
						00 F0
					39 01 00 00 00 00 0B
						CB FF FF FF FF FF FF FF FF FF FF
					39 01 00 00 00 00 02
						00 80
					39 01 00 00 00 00 0B
						CC 26 25 21 22 00 0F 00 0D 00 0B
					39 01 00 00 00 00 02
						00 90
					39 01 00 00 00 00 10
						CC 00 09 01 03 00 00 00 00 00 00 26 25 21 22 00
					39 01 00 00 00 00 02
						00 A0
					39 01 00 00 00 00 10
						CC 10 00 0E 00 0C 00 0A 02 04 00 00 00 00 00 00

					39 01 00 00 00 00 02
						00 80
					39 01 00 00 00 00 0D
						CE 8B 03 06 8A 03 06 89 03 06 88 03 06
					39 01 00 00 00 00 02
						00 90
					39 01 00 00 00 00 0F
						CE F0 00 00 F0 00 00 F0 00 00 F0 00 00 00 00
					39 01 00 00 00 00 02
						00 A0
					39 01 00 00 00 00 0F
						CE 38 03 03 C0 00 06 00 38 02 03 C1 00 06 00
					39 01 00 00 00 00 02
						00 B0
					39 01 00 00 00 00 0F
						CE 38 01 03 C2 00 06 00 38 00 03 C3 00 06 00
					39 01 00 00 00 00 02
						00 C0
					39 01 00 00 00 00 0F
						CE 38 07 03 BC 00 06 00 38 06 03 BD 00 06 00

					39 01 00 00 00 00 02
						00 D0
					39 01 00 00 00 00 0F
						CE 38 05 03 BE 00 06 00 38 04 03 BF 00 06 00
					39 01 00 00 00 00 02
						00 80
					39 01 00 00 00 00 0F
						CF F0 00 00 10 00 00 00 F0 00 00 10 00 00 00
					39 01 00 00 00 00 02
						00 90
					39 01 00 00 00 00 0F
						CF F0 00 00 10 00 00 00 F0 00 00 10 00 00 00
					39 01 00 00 00 00 02
						00 A0
					39 01 00 00 00 00 0F
						CF F0 00 00 10 00 00 00 F0 00 00 10 00 00 00
					39 01 00 00 00 00 02
						00 B0
					39 01 00 00 00 00 0F
						CF F0 00 00 10 00 00 00 F0 00 00 10 00 00 00

					39 01 00 00 00 00 02
						00 C0
					39 01 00 00 00 00 0B
						CF 02 02 20 20 00 00 01 00 00 02

/* + add block 2*/
					39 01 00 00 00 00 02
						00 B1
					39 01 00 00 00 00 02
						C5 28
					39 01 00 00 00 00 02
						00 80
					39 01 00 00 00 00 02
						C4 9C
					39 01 00 00 00 00 02
						00 C0
					39 01 00 00 00 00 02
						C5 00
					39 01 00 00 00 00 02
						00 B2
					39 01 00 00 00 00 05
						F5 15 00 15 00
					39 01 00 00 00 00 02
						00 89
					39 01 00 00 00 00 02
						C0 01
					39 01 00 00 00 00 02
						00 C5
					39 01 00 00 00 00 02
						B0 03
/* - add block 2 */

					39 01 00 00 00 00 02
						00 00
					39 01 00 00 00 00 11
						E1 04 0f 15 0f 08 0f 0A 09 05 08 0e 08 0E 14 10 0B
					39 01 00 00 00 00 02
						00 00
					39 01 00 00 00 00 11
						E2 04 10 15 0E 07 0E 0A 09 04 07 0e 08 0E 14 0f 0B
				];

		qcom,mdss-dsi-on-command-tail = [
					39 01 00 00 00 00 02
						00 00
					39 01 00 00 00 00 04
						ff ff ff ff
					05 01 00 00 78 00 02
						11 00

					05 01 00 00 32 00 02
						29 00];

		qcom,mdss-dsi-on-command-bluelight-mode-0 = [
					/* Standard */
					39 01 00 00 00 00 02
						00 00
					39 01 00 00 00 00 22
						EC 40 44 44 44 44 44 44 44 44 44 44 44 44 44 44 44 44 44 44 44 44 44 44 44 44 44 44 44 44 44 44 44 04

					39 01 00 00 00 00 02
						00 00
					39 01 00 00 00 00 22
						ED 40 44 44 44 44 44 44 44 44 44 44 44 44 44 44 44 44 44 44 44 44 44 44 44 44 44 44 44 44 44 44 44 04

					39 01 00 00 00 00 02
						00 00
					39 01 00 00 00 00 22
						EE 40 44 44 44 44 44 44 44 44 44 44 44 44 44 44 44 44 44 44 44 44 44 44 44 44 44 44 44 44 44 44 44 04
				];
		qcom,mdss-dsi-on-command-bluelight-mode-1 = [
					/* Multimedia */
					39 01 00 00 00 00 02
						00 00
					39 01 00 00 00 00 22
						EC 40 44 44 43 44 44 44 44 34 44 44 44 44 34 44 44 44 44 44 43 44 44 44 44 34 44 44 44 44 34 44 44 04

					39 01 00 00 00 00 02
						00 00
					39 01 00 00 00 00 22
						ED 40 43 43 43 34 34 34 34 44 43 43 43 34 34 34 34 44 43 43 43 34 34 34 34 44 43 43 43 34 34 34 34 04

					39 01 00 00 00 00 02
						00 00
					39 01 00 00 00 00 22
						EE 30 34 34 43 43 33 34 43 43 33 34 34 43 43 33 34 34 43 33 34 34 43 43 33 34 34 43 33 34 34 43 43 03
				];
		qcom,mdss-dsi-on-command-bluelight-mode-2 = [
					/* Web Surfing */
					39 01 00 00 00 00 02
						00 00
					39 01 00 00 00 00 22
						EC 40 44 34 44 44 44 34 44 44 44 34 44 44 44 34 44 44 44 34 44 44 44 34 44 44 44 34 44 44 44 34 44 04

					39 01 00 00 00 00 02
						00 00
					39 01 00 00 00 00 22
						ED 30 34 34 34 34 43 43 43 33 34 34 34 34 43 43 43 33 34 34 34 34 43 43 43 33 34 34 34 34 43 43 43 03

					39 01 00 00 00 00 02
						00 00
					39 01 00 00 00 00 22
						EE 30 33 34 33 33 43 33 33 33 34 33 33 43 33 33 33 34 33 33 33 34 33 33 43 33 33 33 34 33 33 43 33 03
				];
		qcom,mdss-dsi-on-command-bluelight-mode-3 = [
					/* Office */
					39 01 00 00 00 00 02
						00 00
					39 01 00 00 00 00 22
						EC 40 43 44 43 34 44 34 44 34 44 43 44 43 34 44 34 44 43 44 43 34 44 34 44 34 44 43 44 43 34 44 34 04

					39 01 00 00 00 00 02
						00 00
					39 01 00 00 00 00 22
						ED 30 43 33 33 34 33 43 33 33 34 33 43 33 33 34 33 34 33 43 33 33 34 33 43 33 33 34 33 43 33 33 34 03

					39 01 00 00 00 00 02
						00 00
					39 01 00 00 00 00 22
						EE 30 23 33 23 33 33 32 33 23 33 23 33 33 32 33 32 33 23 33 23 33 33 32 33 23 33 23 33 33 32 33 32 03
				];
		qcom,mdss-dsi-on-command-bluelight-mode-4 = [
					/* Reading */
					39 01 00 00 00 00 02
						00 00
					39 01 00 00 00 00 22
						EC 40 43 34 44 34 44 43 34 44 43 34 44 34 44 43 34 44 43 34 44 34 44 43 34 44 43 34 44 34 44 43 34 04

					39 01 00 00 00 00 02
						00 00
					39 01 00 00 00 00 22
						ED 30 33 33 34 33 33 33 33 34 33 33 33 33 43 33 33 33 33 33 34 33 33 33 33 34 33 33 33 33 43 33 33 03

					39 01 00 00 00 00 02
						00 00
					39 01 00 00 00 00 22
						EE 30 32 32 23 23 33 32 32 23 23 23 33 32 32 23 23 33 32 32 23 23 33 32 32 23 23 23 33 32 32 23 23 03
				];

		qcom,mdss-dsi-command-custom-in = [
					39 01 00 00 00 00 02
						00 00
					39 01 00 00 00 00 04
						FF 96 05 01
				];

		qcom,mdss-dsi-command-custom-out = [
					39 01 00 00 00 00 02
						00 00
					39 01 00 00 00 00 04
						ff ff ff ff
				];

		qcom,mdss-dsi-off-command = [05 01 00 00 32 00 02 28 00
					05 01 00 00 78 00 02 10 00];
		qcom,mdss-dsi-on-command-state = "dsi_lp_mode";
		qcom,mdss-dsi-off-command-state = "dsi_hs_mode";
		qcom,mdss-dsi-h-sync-pulse = <1>;
		qcom,mdss-dsi-traffic-mode = "burst_mode";
		qcom,mdss-dsi-bllp-eof-power-mode;
		qcom,mdss-dsi-bllp-power-mode;
		qcom,mdss-dsi-lane-0-state;
		qcom,mdss-dsi-lane-1-state;
		qcom,mdss-dsi-panel-timings = [73 1A 10 00 3E 42 16 1E 15 03 04 00];
		qcom,mdss-dsi-t-clk-post = <0x04>;
		qcom,mdss-dsi-t-clk-pre = <0x1c>;
		qcom,mdss-dsi-bl-min-level = <1>;
		qcom,mdss-dsi-bl-max-level = <255>;
		qcom,mdss-dsi-dma-trigger = "trigger_sw";
		qcom,mdss-dsi-mdp-trigger = "none";
		qcom,mdss-dsi-bl-pmic-control-type = "bl_ctrl_pwm";
		qcom,mdss-dsi-bl-pmic-bank-select = <3>;
		qcom,mdss-dsi-bl-pmic-pwm-frequency = <50>;
		qcom,mdss-dsi-pwm-gpio = <&pm8226_gpios 6 0>;

		qcom,mdss-dsi-reset-sequence = <1 20>, <0 2>, <1 20>;
		/* DSI clock and data lanes should be in LP11 state before
		enabling the hardware reset line for some panels.
		0: dsi clock and data in LP11 state after panel reset
		1: dsi clock and data in LP11 state before panel reset */
		qcom,mdss-dsi-lp11-init = <1>;
		qcom,mdss-dsi-various-on-command;
		qcom,mdss-dsi-on-command-num = <5>;
	};

};
