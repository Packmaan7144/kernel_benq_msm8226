/* Copyright (c) 2013, The Linux Foundation. All rights reserved.
 *
 * This program is free software; you can redistribute it and/or modify
 * it under the terms of the GNU General Public License version 2 and
 * only version 2 as published by the Free Software Foundation.
 *
 * This program is distributed in the hope that it will be useful,
 * but WITHOUT ANY WARRANTY; without even the implied warranty of
 * MERCHANTABILITY or FITNESS FOR A PARTICULAR PURPOSE.  See the
 * GNU General Public License for more details.
 */

/*
 * As a general rule, only version-specific property overrides should be placed
 * inside this file. However, device definitions should be placed inside the
 * msm8226.dtsi file.
 */

/ {
	customer {
		wlanmac           = "000000000000";
		wifibin           = "0";
		btmac             = "000000000000";
		boardid           = "FFFFFFFF";
		boardadc          = "4294967295";
		picasso           = "ZZZZZZZZZZ";
		emmc_wp_size      = "4294967295";
		lcm_exist         = "1";
		imei              = "ZZZZZZZZZZZZZZZ";
		meid              = "ZZZZZZZZZZZZZZZ";
		do_fsck           = "0";
		device_sn         = "ZZZZZZZZZZZZZ";
		st                = "7";
	};
};
